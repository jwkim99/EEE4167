#include <stm32f10x.h>

u8 font8x8[16][8]={
		{0x3c, 0x42, 0x46, 0x4a, 0x52, 0x62, 0x3c, 0x00}, // 0
		{0x10, 0x30, 0x50, 0x10, 0x10, 0x10, 0x7c, 0x00}, // 1
		{0x3c, 0x42, 0x02, 0x0c, 0x30, 0x42, 0x7e, 0x00}, // 2
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		{0x7e, 0x22, 0x28, 0x38, 0x28, 0x20, 0x70, 0x00}  // F
};
u8 revfont8x8[16][8]={
		{0x3C, 0x42, 0x62, 0x52, 0x4A, 0x46, 0x3C, 0x00},	// 0
		{0x08, 0x0C, 0x0A, 0x08, 0x08, 0x08, 0x3E, 0x00},	// 1
		{0x3C, 0x42, 0x40, 0x30, 0x0C, 0x42, 0x7E, 0x00},	// 2
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		{0x7E, 0x44, 0x14, 0x1C, 0x14, 0x04, 0x0E, 0x00},	// F
};

u8 data = 0xF;
u32 row, col, i, key_row, key_col, key_scan, key_index;

int main (void) {

		RCC->APB2ENR = 0x0000081D; // TIM1 & IOP_A-C & AFIO enable
		RCC->APB1ENR = 0x00000002; // TIM3 enable
		GPIOC->CRL = 0x33333333;	// PC0-7 - push_pull output (Dot row)
		GPIOB->CRH = 0x33333333;	// PB8-15 - push_pull output (Dot col)
		GPIOC->CRH = 0x00003333; // PC8-11 - push_pull output (key row)
		GPIOA->CRH = 0x00008888; // PA8-11 - input (key col)
		GPIOA->ODR = 0x0F00; // PA8011 - pull_up switch

		TIM1->CR1 = 0x00;
		TIM1->CR2 = 0x00;
		TIM1->PSC = 0x00F;
		TIM1->ARR = 0x0FF;

		TIM3->CR1 = 0x00;
		TIM3->CR2 = 0x00;
		TIM3->PSC = 0x00FF;
		TIM3->ARR = 0x100;

		TIM1->DIER = 0x0001;
		NVIC->ISER[0] = 0x02000000;
		TIM1->CR1 |= 0x0001;

		TIM3->DIER = 0x0001;
		NVIC->ISER[0] = 0x20000000;
		TIM3->CR1 |= 0x0001;

	
		row = 1;
		col = 0;
		i = 0;

		key_row = 1;
		key_col = 1;

		while (1){;}
} // end main

void TIM1_UP_IRQHandler (void){
		if ((TIM1->SR & 0x0001) != 0){
				GPIOC->ODR = ~row;
				row = row<<1;
				col = font8x8[data][i];
				GPIOB->ODR = col<<8;
				i++;
				if (row == 0x100) {row = 1; i = 0;}
				TIM1->SR &= ~(1<<0); // clear UIF
		}
}

void TIM3_IRQHandler (void) {
		if ((TIM3->SR & 0x0001) != 0){
				GPIOC->BSRR = (~(key_row << 8) & 0x0F00)|(key_row << 24);
				key_col = GPIOA->IDR;
				key_col = (key_col >> 8) & 0x0F;
				key_scan = 0x01;
				for (col = 0; col < 4; col++) {
						if ((key_col & key_scan) == 0)
								data = (u8) key_index;
						key_scan = key_scan << 1;
						key_index = key_index + 1;
				}
				key_row = key_row << 1;
				if (key_row == 0x10) {
						key_row = 0x01;
						key_index = 0;
				}
				TIM3->SR &= ~(1<<0);
		}
}